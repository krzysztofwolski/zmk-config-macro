## boards/shields/blue/Kconfig.defconfig
```kconfig
# Copyright (c) 2020 The ZMK Contributors
# SPDX-License-Identifier: MIT

# if SHIELD_BLUE_LEFT

config ZMK_KEYBOARD_NAME
    default "BLUE"

# config ZMK_SPLIT_ROLE_CENTRAL
#     default y

# endif

# if SHIELD_BLUE_LEFT || SHIELD_BLUE_RIGHT

# config ZMK_SPLIT
#     default y

# endif
```

## boards/shields/blue/Kconfig.shield
```kconfig
# Copyright (c) 2020 The ZMK Contributors
# SPDX-License-Identifier: MIT

config SHIELD_BLUE
    def_bool $(shields_list_contains,blue)
```
